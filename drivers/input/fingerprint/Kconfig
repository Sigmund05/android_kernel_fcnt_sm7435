## drivers/input/fingerprint/Kconfig
```kconfig
config FPC_FINGERPRINT
	tristate "FPC fingerprint sensor support"
	depends on GPIOLIB && OF
	help
	  This option enables support for Fingerprint Cards fpc1020 sensor
	  device driver.

	  To compile this driver as a module, choose M here: the module will
	  be called fpc1020_platform_tee.
```

## drivers/usb/redriver/Kconfig
```kconfig
# SPDX-License-Identifier: GPL-2.0-only

menu "USB3 linear redriver"

config USB_REDRIVER
	tristate "USB super speed (plus) redriver support"
	help
	  USB super speed (plus) redriver chip used to improve
	  USB signal which have long path(USB connector <-->
	  FPC cable <---> USB PHY).

	  Normally this kind of chip have i2c bus interface.

config USB_REDRIVER_NB7VPQ904M
	tristate "NB7VPQ904M USB 3.1 Gen1/Gen2 10Gbps redriver"
	select REGMAP_I2C
	select USB_REDRIVER
	help
	  NB7VPQ904M come from ON-SEMI company,
	  it enhance USB super (plus) signal on mobile platform.
	  it have i2c program interface.
	  Say Y/M here if you want to support it.

config USB_REDRIVER_PS5169
	tristate "Parade PS5169 USB Type-C linear redriver"
	depends on I2C
	select REGMAP_I2C
	select USB_REDRIVER
	help
	  This driver supports the Parade PS5169, a linear redriver for
	  USB 3.2 and DisplayPort signals on USB Type-C ports, which is
	  controlled over I2C.

	  This driver can also be built as a module. If so, the module
	  will be called ps5169.

endmenu
```
